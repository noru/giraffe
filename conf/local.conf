## conf/local.conf
```bitbake
include "base"

app {
  mode = "local"
  cache {
    defaultTTL = 30 // in seconds, -1 = OFF, 0 = Infinite
  }
}

# Database configuration
slick.dbs.mysql.db = {
  url = "jdbc:mysql://localhost:3306/giraffe"
  user = "root"
  password = "root"
}

// Cache
redis {
  host = "localhost"
}
```
